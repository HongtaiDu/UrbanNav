## CMakeLists.txt
```
cmake_minimum_required(VERSION 3.20.0)
find_package(Zephyr REQUIRED HINTS $ENV{ZEPHYR_BASE})

project(beacon)

target_sources(app PRIVATE src/main.c)
```

## prj.conf
```kconfig
# Enable Bluetooth stack
CONFIG_BT=y

# Set the name that shows up on your phone
CONFIG_BT_DEVICE_NAME="Test_Beacon_01"

# Required for your Pro Micro to generate the drag-and-drop file
CONFIG_BUILD_OUTPUT_UF2=y

# Optimization for low power (good for your "product features")
CONFIG_LOG=n
```

## src/main.c
```c
#include <zephyr/types.h>
#include <stddef.h>
#include <zephyr/sys/printk.h>
#include <zephyr/sys/util.h>
#include <zephyr/kernel.h>
#include <zephyr/bluetooth/bluetooth.h>
#include <zephyr/bluetooth/hci.h>

/* Define the Advertising Data */
static const struct bt_data ad[] = {
    BT_DATA_BYTES(BT_DATA_FLAGS, BT_LE_AD_GENERAL | BT_LE_AD_NO_BREDR),
    BT_DATA(BT_DATA_NAME_COMPLETE, CONFIG_BT_DEVICE_NAME, sizeof(CONFIG_BT_DEVICE_NAME) - 1),
};

void main(void)
{
    int err;

    printk("Starting UrbanNAV Beacon Test\n");

    /* Initialize the Bluetooth Subsystem */
    err = bt_enable(NULL);
    if (err) {
        printk("Bluetooth init failed (err %d)\n", err);
        return;
    }

    printk("Bluetooth initialized\n");

    /* Start advertising: Non-connectable, 100ms interval */
    err = bt_le_adv_start(BT_LE_ADV_NCONN_IDENTITY, ad, ARRAY_SIZE(ad), NULL, 0);
    if (err) {
        printk("Advertising failed to start (err %d)\n", err);
        return;
    }

    printk("Beacon is now broadcasting. Check your phone!\n");
}
```
